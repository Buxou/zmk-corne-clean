## config/Kconfig.shield
```kconfig
# Copyright (c) 2020 The ZMK Contributors
# SPDX-License-Identifier: MIT

config SHIELD_ENKI42_LEFT
	def_bool $(shields_list_contains,corne_left)

config SHIELD_ENKI42_RIGHT
	def_bool $(shields_list_contains,corne_right)

config SHIELD_ENKI42_DONGLE
	def_bool $(shields_list_contains,corne_dongle)
```
